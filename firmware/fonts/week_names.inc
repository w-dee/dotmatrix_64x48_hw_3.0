// Generated by make_digits.rb from week_names.png
static constexpr int WEEK_NAMES_COUNT = 7;
static const PROGMEM char WEEK_NAMES_BITMAP[] = 
"\x00\x2c\xc0\xf5\xf4\xc4\x33\x00\x00\x00\x00\x00\x00\x00\x00\x00\x00\x00\x00\x00\x00\x00"
"\x00\xd4\xff\xff\xff\xff\xd6\x00\x00\x00\x00\x00\x00\x00\x00\x00\x00\x00\x00\x00\x00\x00"
"\x00\xf1\xff\x41\x00\x00\x00\x00\xff\xff\x00\xff\xff\x00\xff\xdc\x4d\xb3\x48\x00\x00\x00"
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"\x00\x37\xcb\xf8\xf6\xb8\x1f\x00\x8a\xf4\xbd\xe1\xff\x1c\x00\x90\xf9\xd5\x00\x00\x00\x00"

;
static const PROGMEM glyph_t WEEK_NAMES_array[WEEK_NAMES_COUNT] = {
{ (const PROGMEM uint8_t *)(WEEK_NAMES_BITMAP + 0) ,  '0', 22, 8, 0 },
{ (const PROGMEM uint8_t *)(WEEK_NAMES_BITMAP + 176) ,  '1', 22, 8, 0 },
{ (const PROGMEM uint8_t *)(WEEK_NAMES_BITMAP + 352) ,  '2', 22, 8, 0 },
{ (const PROGMEM uint8_t *)(WEEK_NAMES_BITMAP + 528) ,  '3', 22, 8, 0 },
{ (const PROGMEM uint8_t *)(WEEK_NAMES_BITMAP + 704) ,  '4', 22, 8, 0 },
{ (const PROGMEM uint8_t *)(WEEK_NAMES_BITMAP + 880) ,  '5', 22, 8, 0 },
{ (const PROGMEM uint8_t *)(WEEK_NAMES_BITMAP + 1056) ,  '6', 22, 8, 0 },
};

static const PROGMEM glyph_header_t WEEK_NAMES = {
WEEK_NAMES_array, WEEK_NAMES_COUNT, 8+1};

