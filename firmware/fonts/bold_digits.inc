// Generated by make_digits.rb from bold_digits.png
static constexpr int BOLD_DIGITS_COUNT = 10;
static const PROGMEM char BOLD_DIGITS_BITMAP[] = 
"\x1a\xbc\xf2\xbf\x1a\x00"
"\xa7\xff\xff\xff\x9e\x00"
"\xe5\xff\x4a\xff\xdc\x00"
"\xfb\xff\x08\xff\xf5\x00"
"\xf6\xff\x07\xff\xfa\x00"
"\xdf\xff\x50\xff\xe3\x00"
"\xa0\xff\xff\xff\xa6\x00"
"\x1b\xc7\xf6\xc1\x1a\x00"

"\x00\x17\xe9\xff\x00\x00"
"\x38\xce\xff\xff\x00\x00"
"\xff\xf3\xff\xff\x00\x00"
"\xc0\x2b\xff\xff\x00\x00"
"\x00\x00\xff\xff\x00\x00"
"\x00\x00\xff\xff\x00\x00"
"\x00\x00\xff\xff\x00\x00"
"\x00\x00\xff\xff\x00\x00"

"\x2a\xd1\xfa\xda\x3f\x00"
"\xb9\xff\xff\xff\xd7\x00"
"\xd4\xf6\x3c\xff\xf7\x00"
"\x00\x00\x30\xff\xbe\x00"
"\x00\x2e\xe9\xe8\x29\x00"
"\x1b\xec\xd4\x1f\x00\x00"
"\x9c\xff\xff\xff\xff\x00"
"\xe8\xff\xff\xff\xff\x00"

"\x2f\xcc\xf7\xdc\x4f\x00"
"\xcf\xff\xff\xff\xea\x00"
"\x00\x00\x2a\xff\xc4\x00"
"\x00\x00\xf1\xed\x2c\x00"
"\x00\x00\x2a\xff\xca\x00"
"\xbe\xf0\x42\xff\xf7\x00"
"\xa1\xff\xff\xff\xc0\x00"
"\x19\xc5\xf9\xd2\x2b\x00"

"\x00\x00\x4c\xff\xff\x00"
"\x00\x07\xdc\xff\xff\x00"
"\x00\x7a\xff\xff\xff\x00"
"\x1c\xf4\xce\xff\xff\x00"
"\xa9\xfc\x33\xff\xff\x00"
"\xff\xff\xff\xff\xff\xff"
"\xff\xff\xff\xff\xff\xff"
"\x00\x00\x00\xff\xff\x00"

"\x53\xff\xff\xff\xff\x00"
"\x79\xff\xff\xff\xff\x00"
"\x9e\xff\x58\x00\x00\x00"
"\xc4\xff\xd5\xea\x4b\x00"
"\xe9\xff\xff\xff\xda\x00"
"\x22\x2e\x29\xff\xf7\x00"
"\xd0\xff\xff\xff\xbe\x00"
"\x31\xd0\xf8\xce\x29\x00"

"\x0a\xa4\xf1\xdc\x35\x00"
"\x8f\xff\xff\xff\xcd\x00"
"\xdd\xff\x39\x00\x00\x00"
"\xfa\xff\x9a\xea\x46\x00"
"\xf8\xff\xfe\xff\xd4\x00"
"\xde\xff\x4b\xff\xf8\x00"
"\x93\xff\xff\xff\xce\x00"
"\x12\xba\xf7\xd9\x37\x00"

"\xff\xff\xff\xff\xff\x00"
"\xff\xff\xff\xff\xf3\x00"
"\x00\x00\x1b\xf1\x75\x00"
"\x00\x00\xaa\xe8\x05\x00"
"\x00\x27\xfe\x94\x00\x00"
"\x00\x7e\xff\x53\x00\x00"
"\x00\xbe\xff\x26\x00\x00"
"\x00\xea\xff\x0b\x00\x00"

"\x35\xd2\xf6\xcc\x35\x00"
"\xd5\xff\xff\xff\xd6\x00"
"\xef\xff\x48\xff\xf0\x00"
"\x64\xf7\xff\xfd\x6a\x00"
"\x73\xfa\xff\xfe\x76\x00"
"\xf4\xff\x4b\xff\xf2\x00"
"\xdf\xff\xff\xff\xd4\x00"
"\x47\xdd\xfa\xd8\x3f\x00"

"\x34\xd7\xf6\xb6\x10\x00"
"\xcd\xff\xff\xff\x91\x00"
"\xf9\xff\x4b\xff\xdd\x00"
"\xd6\xff\xfe\xff\xf8\x00"
"\x4a\xeb\x9a\xff\xf9\x00"
"\x00\x00\x39\xff\xdb\x00"
"\xce\xff\xff\xff\x8c\x00"
"\x37\xe0\xf2\xa5\x0b\x00"

;
static const PROGMEM glyph_t BOLD_DIGITS_array[BOLD_DIGITS_COUNT] = {
{ (const PROGMEM uint8_t *)(BOLD_DIGITS_BITMAP + 0) ,  '0', 6, 8, 6 },
{ (const PROGMEM uint8_t *)(BOLD_DIGITS_BITMAP + 48) ,  '1', 6, 8, 6 },
{ (const PROGMEM uint8_t *)(BOLD_DIGITS_BITMAP + 96) ,  '2', 6, 8, 6 },
{ (const PROGMEM uint8_t *)(BOLD_DIGITS_BITMAP + 144) ,  '3', 6, 8, 6 },
{ (const PROGMEM uint8_t *)(BOLD_DIGITS_BITMAP + 192) ,  '4', 6, 8, 6 },
{ (const PROGMEM uint8_t *)(BOLD_DIGITS_BITMAP + 240) ,  '5', 6, 8, 6 },
{ (const PROGMEM uint8_t *)(BOLD_DIGITS_BITMAP + 288) ,  '6', 6, 8, 6 },
{ (const PROGMEM uint8_t *)(BOLD_DIGITS_BITMAP + 336) ,  '7', 6, 8, 6 },
{ (const PROGMEM uint8_t *)(BOLD_DIGITS_BITMAP + 384) ,  '8', 6, 8, 6 },
{ (const PROGMEM uint8_t *)(BOLD_DIGITS_BITMAP + 432) ,  '9', 6, 8, 6 },
};

static const PROGMEM glyph_header_t BOLD_DIGITS = {
BOLD_DIGITS_array, BOLD_DIGITS_COUNT, 8+1};

