// Generated by make_digits.rb from large_digits.png
static constexpr int LARGE_DIGITS_COUNT = 10;
static const PROGMEM char * LARGE_DIGITS_BITMAP = 
"\x00\x00\x00\x08\x76\xce\xf4\xf4\xcd\x75\x07\x00\x00\x00"
"\x00\x00\x11\xcc\xff\xff\xff\xff\xff\xff\xca\x10\x00\x00"
"\x00\x00\xa1\xff\xff\xff\xff\xff\xff\xff\xff\x9f\x00\x00"
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"\x00\x00\x00\x5c\xc3\xf3\xf8\xde\x9a\x29\x00\x00\x00\x00"

;
static const PROGMEM glyph_t LARGE_DIGITS_array[LARGE_DIGITS_COUNT] = {
{ (const PROGMEM uint8_t *)(LARGE_DIGITS_BITMAP + 0) ,  '0', 14, 18, 15 },
{ (const PROGMEM uint8_t *)(LARGE_DIGITS_BITMAP + 252) ,  '1', 14, 18, 15 },
{ (const PROGMEM uint8_t *)(LARGE_DIGITS_BITMAP + 504) ,  '2', 14, 18, 15 },
{ (const PROGMEM uint8_t *)(LARGE_DIGITS_BITMAP + 756) ,  '3', 14, 18, 15 },
{ (const PROGMEM uint8_t *)(LARGE_DIGITS_BITMAP + 1008) ,  '4', 14, 18, 15 },
{ (const PROGMEM uint8_t *)(LARGE_DIGITS_BITMAP + 1260) ,  '5', 14, 18, 15 },
{ (const PROGMEM uint8_t *)(LARGE_DIGITS_BITMAP + 1512) ,  '6', 14, 18, 15 },
{ (const PROGMEM uint8_t *)(LARGE_DIGITS_BITMAP + 1764) ,  '7', 14, 18, 15 },
{ (const PROGMEM uint8_t *)(LARGE_DIGITS_BITMAP + 2016) ,  '8', 14, 18, 15 },
{ (const PROGMEM uint8_t *)(LARGE_DIGITS_BITMAP + 2268) ,  '9', 14, 18, 15 },
};

static const PROGMEM glyph_header_t LARGE_DIGITS = {
LARGE_DIGITS_array, LARGE_DIGITS_COUNT, 18+1};

